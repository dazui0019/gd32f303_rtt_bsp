## board/Kconfig
```kconfig
menu "Hardware Drivers Config"

config SOC_SERIES_GD32F30x
    bool
    default y

config SOC_GD32303Z
    bool
    select SOC_SERIES_GD32F30x
    select RT_USING_COMPONENTS_INIT
    select RT_USING_USER_MAIN
    default y

menu "Onboard Peripheral Drivers"

endmenu

menu "On-chip Peripheral Drivers"

    config BSP_USING_GPIO
        bool "Enable GPIO"
        select RT_USING_PIN
        default y

    config BSP_USING_SPI_FLASH
        bool "Enable SPI FLASH (W25Q64 spi1)"
        select RT_USING_SPI
        select BSP_USING_SPI
        select BSP_USING_SPI1
        default n

    menuconfig BSP_USING_SPI
        bool "Enable SPI BUS"
        default n
        select RT_SUGIN_SPI
        if BSP_USING_SPI

            config BSP_USING_SPI0
                bool "Enable SPI0 Bus"
                default n

            config BSP_USING_SPI1
                bool "Enable SPI1 Bus"
                default n

            config BSP_USING_SPI2
                bool "Enable SPI2 Bus"
                default n
        endif

    menuconfig BSP_USING_UART
        bool "Enable UART"
        default y
        select RT_USING_SERIAL
        if BSP_USING_UART

            config BSP_USING_UART0
                bool "Enable UART0"
                default n

            config BSP_USING_UART1
                bool "Enable UART1"
                default y

            config BSP_UART1_RX_USING_DMA
                bool "Enable UART1 RX DMA"
                depends on BSP_USING_UART1
                select RT_SERIAL_USING_DMA
                default n

        endif

    source "libraries/gd32_drivers/Kconfig"

endmenu

menu "Board extended module Drivers"

endmenu

endmenu
```
